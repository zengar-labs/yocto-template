## meta-hell/conf/layer.conf
```bitbake
# We have a conf and classes directory, add to BBPATH
BBPATH .= ":${LAYERDIR}"

# We have recipes-* directories, add to BBFILES
BBFILES += "${LAYERDIR}/recipes-*/*/*.bb \
            ${LAYERDIR}/recipes-*/*/*.bbappend"

BBFILE_COLLECTIONS += "meta-hell"
BBFILE_PATTERN_meta-hell = "^${LAYERDIR}/"
BBFILE_PRIORITY_meta-hell = "6"

LAYERDEPENDS_meta-hell = "core"
LAYERSERIES_COMPAT_meta-hell = "hardknott kirkstone"
```
